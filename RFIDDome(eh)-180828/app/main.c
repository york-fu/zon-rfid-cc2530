/*********************************************************************************************
* 文件：main.c
* 作者：fuyou 2018.03.22
* 说明：rfid el驱动
* 修改：
* 注释：
*********************************************************************************************/

/*********************************************************************************************
* 头文件
*********************************************************************************************/
#include "main.h"


/*********************************************************************************************
* 名称：main
* 功能：主函数
* 参数：无
* 返回：无
* 修改：
* 注释：
*********************************************************************************************/
void main(void)
{	
    u8 etcFlag=0;                                               //刷卡标志
    u8 epcBuf[12]={0};

	xtal_init();   
	uart0_init(115200);											//UART0初始化
	uart1_init(115200);											//UART1初始化
	led_init();                                                 //LED初始化
    sticks_ioInit();                                            //栏杆io初始化
    time1Int_init();                                            //定时器中断初始化
    
	while(1)
	{
        pc_eh();									            //eh控制
        
        if(t1Update)
        {
            t1Update = 0;
            if(mcuReadEtcEpc(epcBuf))                           //读取到卡号
            {
                if(etcFlag)
                {
                    etcFlag = 0;
                    reported_etcInfoV2(epcBuf);                 //上报etc卡信息
                }
            }
            else
            {
                etcFlag = 1;
            }
        }
    }
}
